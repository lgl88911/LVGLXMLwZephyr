## boards/vendor/halfcoder/esp32s3_touch_lcd_2/Kconfig
```kconfig
# Copyright (c) 2025, Frank Li<lgl88911@163.com>

config HEAP_MEM_POOL_ADD_SIZE_BOARD
	int
	default 4096 if BOARD_ESP32S3_TOUCH_LCD_2_ESP32S3_PROCPU
	default 256 if BOARD_ESP32S3_TOUCH_LCD_2_ESP32S3_APPCPU
```

## boards/vendor/halfcoder/esp32s3_touch_lcd_2/Kconfig.defconfig
```kconfig
# Copyright (c) 2025, Frank Li<lgl88911@163.com>

if BOARD_ESP32S3_TOUCH_LCD_2_ESP32S3_PROCPU

config KERNEL_MEM_POOL
	default y

config PWM
	default y if DISPLAY

configdefault LV_COLOR_16_SWAP
	default y if LVGL

endif # BOARD_ESP32S3_TOUCH_LCD_1_28_ESP32S3_PROCPU
```

## boards/vendor/halfcoder/esp32s3_touch_lcd_2/Kconfig.esp32s3_touch_lcd_2
```kconfig
# Copyright (c) 2025, Frank Li<lgl88911@163.com>

config BOARD_ESP32S3_TOUCH_LCD_2
	select SOC_ESP32S3_WROOM_N16R8
	select SOC_ESP32S3_PROCPU if BOARD_ESP32S3_TOUCH_LCD_2_ESP32S3_PROCPU
	select SOC_ESP32S3_APPCPU if BOARD_ESP32S3_TOUCH_LCD_2_ESP32S3_APPCPU
```

## boards/vendor/halfcoder/esp32s3_touch_lcd_2/board.yml
```yaml
# Copyright (c) 2025, Frank Li<lgl88911@163.com>
board:
  name: esp32s3_touch_lcd_2
  full_name: ESP32-S3-Touch-LCD-2
  vendor: halfcoder
  socs:
  - name: esp32s3
```

## boards/vendor/halfcoder/esp32s3_touch_lcd_2/esp32s3_touch_lcd_2_esp32s3_appcpu_defconfig
```kconfig
# Copyright (c) 2025, Frank Li<lgl88911@163.com>
# SPDX-License-Identifier: Apache-2.0

CONFIG_CLOCK_CONTROL=y
```

## boards/vendor/halfcoder/esp32s3_touch_lcd_2/esp32s3_touch_lcd_2_esp32s3_procpu_defconfig
```kconfig
# Copyright (c) 2025, Frank Li<lgl88911@163.com>

CONFIG_GPIO=y
CONFIG_REGULATOR=y
CONFIG_CONSOLE=y
CONFIG_SERIAL=y
CONFIG_UART_CONSOLE=y
CONFIG_CLOCK_CONTROL=y
CONFIG_INPUT=y
CONFIG_INPUT_CST816S_INTERRUPT=n

CONFIG_HEAP_MEM_POOL_SIZE=163840
CONFIG_DISPLAY=y
```

## west.yml
```yaml
# Copyright (c) 2025, Frank Li<lgl88911@163.com>

manifest:
  self:
    west-commands: scripts/west-commands.yml

  remotes:
    - name: zephyrproject-rtos
      url-base: https://github.com/zephyrproject-rtos

  projects:
    - name: zephyr
      remote: zephyrproject-rtos
      revision: v4.2.0
      import:
        # By using name-allowlist we can clone only the modules that are
        # strictly needed by the application.
        name-allowlist:
          - hal_espressif
          - lvgl
          - picolibc
```
